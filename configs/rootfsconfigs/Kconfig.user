## configs/rootfsconfigs/Kconfig.user
```kconfig
menu "user packages " 
config gpio-demo  
	 bool "gpio-demo"
	 help
	
config peekpoke  
	 bool "peekpoke"
	 help
	
config vortex-app  
	 bool "vortex-app"
	 help
	
config vortexdriver  
	 bool "vortexdriver"
	 help
	
endmenu
```
